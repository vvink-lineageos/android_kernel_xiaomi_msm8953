#include "../tissot/msm-audio-tissot.dtsi"
#include "../tissot/msm-pm8953-tissot.dtsi"
#include "../tissot/msm-pmi8950-tissot.dtsi"
#include "msm8953-pinctrl-daisy.dtsi"
#include "../tissot/msm8953-audio-tissot.dtsi"
#include "../tissot/msm8953-camera-sensor-qrd-tissot.dtsi"
#include "dsi-panel-ili7807-fhdplus-video.dtsi"
#include "dsi-panel-otm1911-fhdplus-video.dtsi"
#include "../tissot/msm8953-pm-tissot.dtsi"
#include "msm8953-qrd-sku3-daisy.dtsi"
#include "msm8953-daisy.dtsi"
#include "../tissot/msm8953-qrd-tissot.dtsi"
#include "../tissot/msm8953-regulator-tissot.dtsi"
